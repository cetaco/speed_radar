## build/Kconfig/arch/Kconfig
```kconfig
# Load Zephyr Arch Kconfig descriptions.
osource "/home/cetaco/zephyrproject/zephyr/arch/rx/Kconfig"
osource "/home/cetaco/zephyrproject/zephyr/arch/x86/Kconfig"
osource "/home/cetaco/zephyrproject/zephyr/arch/xtensa/Kconfig"
osource "/home/cetaco/zephyrproject/zephyr/arch/sparc/Kconfig"
osource "/home/cetaco/zephyrproject/zephyr/arch/riscv/Kconfig"
osource "/home/cetaco/zephyrproject/zephyr/arch/posix/Kconfig"
osource "/home/cetaco/zephyrproject/zephyr/arch/mips/Kconfig"
osource "/home/cetaco/zephyrproject/zephyr/arch/arm64/Kconfig"
osource "/home/cetaco/zephyrproject/zephyr/arch/arm/Kconfig"
osource "/home/cetaco/zephyrproject/zephyr/arch/arc/Kconfig"
```

## build/Kconfig/boards/Kconfig.defconfig
```kconfig
# Load Zephyr board defconfig descriptions.
osource "/home/cetaco/zephyrproject/zephyr/boards/arm/mps2/Kconfig.defconfig"
```

## build/Kconfig/boards/Kconfig.mps2
```kconfig
# Load board Kconfig descriptions.
osource "/home/cetaco/zephyrproject/zephyr/boards/arm/mps2/Kconfig.mps2"
```

## build/Kconfig/boards/Kconfig.sysbuild
```kconfig
# Load Sysbuild board Kconfig descriptions.
osource "/home/cetaco/zephyrproject/zephyr/boards/arm/mps2/Kconfig.sysbuild"
```
